/dts-v1/;
/plugin/;

/* SPI1 */
/ {

    compatible = "ti,beaglebone", "ti,beaglebone-black";

    part-number = "spi1mux";

 fragment@0 {
        target = <&am33xx_pinmux>;
        __overlay__ {
            spi1_pins_s0: spi1_pins_s0 {
                        pinctrl-single,pins = <
                                0x190 0x33
                                0x194 0x33
                                0x198 0x13
                                0x19c 0x13
                >;
            };
        };
    };


    fragment@1 {
        target = <&spi1>;
        __overlay__ {
             #address-cells = <1>;
             #size-cells = <0>;
             status = "okay";
             pinctrl-names = "default";
             pinctrl-0 = <&spi1_pins_s0>;

        };
    };
};
